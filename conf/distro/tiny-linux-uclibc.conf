## conf/distro/tiny-linux-uclibc.conf
```bitbake
require conf/distro/poky.conf

DISTRO = "tiny-linux-uclibc"

POKY_DEFAULT_EXTRA_RRECOMMENDS = ""

TCLIBCAPPEND = ""

ENABLE_WIDEC="false"

USE_NLS="no"

ASSUME_PROVIDED += "pkgconfig$"

DISTRO_FEATURES_LIBC = "largefile"
DISTRO_FEATURES_NET = "ipv4"
DISTRO_FEATURES = "${DISTRO_FEATURES_NET} \
                   ${DISTRO_FEATURES_LIBC} \
                  "
TCLIBC = "uclibc"

VIRTUAL-RUNTIME_dev_manager = ""
VIRTUAL-RUNTIME_login_manager = ""
VIRTUAL-RUNTIME_init_manager = "tiny-init"
VIRTUAL-RUNTIME_keymaps = ""

IMAGE_FSTYPES += "ext2 cpio.gz"

MACHINE_ESSENTIAL_EXTRA_RDEPENDS = ""

RDEPENDS_${PN}-mtrace_pn-eglibc = ""

INHERIT += "blacklist"

PNBLACKLIST[build-appliance-image] = "not buildable with poky-tiny"
PNBLACKLIST[core-image-base] = "not buildable with poky-tiny"
PNBLACKLIST[core-image-basic] = "not buildable with poky-tiny"
PNBLACKLIST[core-image-clutter] = "not buildable with poky-tiny"
PNBLACKLIST[core-image-directfb] = "not buildable with poky-tiny"
PNBLACKLIST[core-image-lsb] = "not buildable with poky-tiny"
PNBLACKLIST[core-image-lsb-dev] = "not buildable with poky-tiny"
PNBLACKLIST[core-image-lsb-sdk] = "not buildable with poky-tiny"
PNBLACKLIST[core-image-rt] = "not buildable with poky-tiny"
PNBLACKLIST[core-image-rt-sdk] = "not buildable with poky-tiny"
PNBLACKLIST[core-image-sato] = "not buildable with poky-tiny"
PNBLACKLIST[core-image-sato-dev] = "not buildable with poky-tiny"
PNBLACKLIST[core-image-sato-sdk] = "not buildable with poky-tiny"
PNBLACKLIST[core-image-x11] = "not buildable with poky-tiny"
PNBLACKLIST[qt4e-demo-image] = "not buildable with poky-tiny"
```

## conf/machine/hachiko64.conf
```bitbake
#@TYPE: Machine
#@NAME: ude

#@DESCRIPTION: Machine configuration for renesas systems

# Ship all kernel modules by default
MACHINE_EXTRA_RRECOMMENDS = " kernel-modules"

DEFAULTTUNE = "cortexa9thf-neon"
include conf/machine/include/tune-cortexa9.inc

IMAGE_FSTYPES += "tar.bz2 jffs2 squashfs"
EXTRA_IMAGECMD_jffs2 = "-lnp "

PREFERRED_PROVIDER_virtual/kernel = "linux"
PREFERRED_VERSION_linux = "3.8.13"

KERNEL_DEVICETREE = "${S}/arch/arm/boot/dts/rza1-hachiko.dts"

EXTRA_IMAGEDEPENDS += "u-boot"
PREFERRED_PROVIDER_u-boot = "u-boot"
PREFERRED_VERSION_u-boot = "2013.04"
UBOOT_MACHINE = "hachiko_64"

KERNEL_IMAGETYPE = "uImage"

SERIAL_CONSOLES = "115200;ttySC3"
```
